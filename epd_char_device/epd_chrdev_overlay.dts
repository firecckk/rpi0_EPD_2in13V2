/dts-v1/;
/plugin/;

/ {
    compatible = "brcm,bcm2835";

    fragment@0 {
        target = <&spi0>;
        __overlay__ {
            status = "okay";
	    #address-cells = <1>;
            #size-cells = <0>;
            
            epd@1 {
                compatible = "waveshare,epd2in13v2";
                reg = <1>;
                spi-max-frequency = <10000000>;

                dc-gpios = <&gpio 25 0>;     
                reset-gpios = <&gpio 17 0>;  
                busy-gpios = <&gpio 24 0>;   
                pwr-gpios = <&gpio 18 0>;    
            };
        };
    };
};
